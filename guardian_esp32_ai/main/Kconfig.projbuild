## guardian_esp32_ai/main/Kconfig.projbuild
```kconfig
menu "Guardian AI Assistant"

config GUARDIAN_WS_URL
    string "Guardian AI WebSocket URL"
    default "ws://192.168.1.100:8765"
    help
        Guardian Cloud AI server WebSocket address.
        Format: ws://IP:PORT
        Example: ws://192.168.1.100:8765

config GUARDIAN_WS_TOKEN
    string "WebSocket Auth Token (optional)"
    default ""
    help
        Optional Bearer token for authentication.
        Leave empty if no authentication is required.

config GUARDIAN_WS_VERSION
    int "WebSocket Protocol Version"
    default 3
    range 1 3
    help
        Protocol version: 1=raw Opus, 2=BinaryProtocol2, 3=BinaryProtocol3

config USE_AUDIO_PROCESSOR
    bool "Enable Audio Noise Reduction (AFE: VAD + NS)"
    default y
    depends on IDF_TARGET_ESP32S3 && SPIRAM
    help
        Enable ESP-SR AFE audio front-end (VAD + neural network noise suppression).
        Requires ESP32-S3 with PSRAM.

config USE_DEVICE_AEC
    bool "Enable Device-Side AEC (requires reference channel)"
    default n
    depends on USE_AUDIO_PROCESSOR
    help
        Enable acoustic echo cancellation using the speaker playback reference signal.
        Requires the audio codec to supply a reference channel (input_reference() == true).

config USE_AFE_WAKE_WORD
    bool "Enable AFE Wake Word Detection (requires ESP32-S3 + PSRAM)"
    default n
    depends on USE_AUDIO_PROCESSOR
    help
        Enable hands-free wake word detection using ESP-SR wakenet inside the AFE
        pipeline. Requires ESP32-S3 with PSRAM and a wakenet model in the 'model'
        SPIFFS partition (compiled in by idf_component.yml esp-sr dependency).
        When detected the device automatically starts listening.

endmenu

menu "Sensor Gateway (UART -> MQTT)"
    comment "MQTT credentials for EMQX Cloud. WiFi credentials come from NVS (wifi_config.csv)."

config GW_MQTT_BROKER_URI
    string "MQTT Broker URI"
    default "mqtts://b1117f90.ala.cn-hangzhou.emqxsl.cn:8883"
    help
        Full URI including scheme and port.
        mqtts:// for TLS (port 8883), mqtt:// for plain (port 1883).

config GW_MQTT_USERNAME
    string "MQTT Username"
    default "user1"

config GW_MQTT_PASSWORD
    string "MQTT Password"
    default "12345"

config GW_MQTT_DEVICE_ID_DEFAULT
    string "MQTT Device ID (compile-time default)"
    default "001"
    help
        Device ID used in MQTT topics: guardian/<device_id>/<sensor>.
        Runtime value is read from NVS namespace "mqtt", key "device_id"
        (set via wifi_config.csv). This is the fallback when NVS is blank.

endmenu
```

## guardian_esp32_ai/sdkconfig.defaults
```kconfig
# Guardian ESP32-S3 SDK defaults
# ESP32-S3 with PSRAM (INMP441 + MAX98357A)

CONFIG_IDF_TARGET="esp32s3"

# PSRAM
CONFIG_SPIRAM=y
CONFIG_SPIRAM_MODE_OCT=y
CONFIG_SPIRAM_SPEED_80M=y

# Stack sizes
CONFIG_ESP_MAIN_TASK_STACK_SIZE=8192

# Flash — 16MB (ESP32-S3 N16R8)，自定义分区表
CONFIG_ESPTOOLPY_FLASHSIZE_16MB=y
CONFIG_PARTITION_TABLE_CUSTOM=y
CONFIG_PARTITION_TABLE_CUSTOM_FILENAME="partitions.csv"
CONFIG_PARTITION_TABLE_OFFSET=0x8000

# FreeRTOS
CONFIG_FREERTOS_HZ=1000

# Log level
CONFIG_LOG_DEFAULT_LEVEL_INFO=y

# Wake word: 你好小智 (wn9_nihaoxiaozhi_tts) — WakeNet9, Chinese, high-perf
# Matches esp_srmodel_init("model") in afe_wake_word.cc which scans for ESP_WN_PREFIX
CONFIG_USE_AFE_WAKE_WORD=y
CONFIG_USE_AUDIO_PROCESSOR=y
CONFIG_SR_WN_WN9_NIHAOXIAOZHI_TTS=y
```
