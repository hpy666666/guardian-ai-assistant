/dts-v1/;
/plugin/;

/ {
	fragment@0 {
		target-path = "/reserved-memory";

		__overlay__ {
			#address-cells = <0x02>;
			#size-cells = <0x02>;
			ranges;

			linux,cma {
				compatible = "shared-dma-pool";
				reusable;
				size = <0x00 0x8000000>;
				linux,cma-default;
			};
		};
	};
};
