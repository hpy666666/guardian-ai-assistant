/*
 * OLED SSD1306 Driver (128x64, I2C)
 * Target: STM32F407 + RT-Thread standard edition
 */

#include "oled_ssd1306.h"
#include <string.h>

#define DBG_TAG "oled"
#define DBG_LVL DBG_LOG
#include <rtdbg.h>

/*---------------------------------------------------------------------------
 * SSD1306 Commands
 *---------------------------------------------------------------------------*/
#define SSD1306_CMD_DISPLAY_OFF         0xAE
#define SSD1306_CMD_DISPLAY_ON          0xAF
#define SSD1306_CMD_SET_CONTRAST        0x81
#define SSD1306_CMD_ENTIRE_DISPLAY_RAM  0xA4
#define SSD1306_CMD_ENTIRE_DISPLAY_ON   0xA5
#define SSD1306_CMD_NORMAL_DISPLAY      0xA6
#define SSD1306_CMD_INVERT_DISPLAY      0xA7
#define SSD1306_CMD_SET_MUX_RATIO       0xA8
#define SSD1306_CMD_SET_DISPLAY_OFFSET  0xD3
#define SSD1306_CMD_SET_START_LINE      0x40
#define SSD1306_CMD_SET_SEG_REMAP       0xA1
#define SSD1306_CMD_SET_COM_SCAN_DEC    0xC8
#define SSD1306_CMD_SET_COM_PINS        0xDA
#define SSD1306_CMD_SET_CLK_DIV         0xD5
#define SSD1306_CMD_SET_PRECHARGE       0xD9
#define SSD1306_CMD_SET_VCOMH           0xDB
#define SSD1306_CMD_CHARGE_PUMP         0x8D
#define SSD1306_CMD_MEMORY_MODE         0x20
#define SSD1306_CMD_SET_COL_ADDR        0x21
#define SSD1306_CMD_SET_PAGE_ADDR       0x22

/*---------------------------------------------------------------------------
 * 6x8 ASCII Font (partial, space to ~)
 *---------------------------------------------------------------------------*/
static const rt_uint8_t font_6x8[][6] = {
    {0x00,0x00,0x00,0x00,0x00,0x00}, // space
    {0x00,0x00,0x5F,0x00,0x00,0x00}, // !
    {0x00,0x07,0x00,0x07,0x00,0x00}, // "
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    {0x08,0x08,0x2A,0x1C,0x08,0x00}, // ~
};

/*---------------------------------------------------------------------------
 * 8x16 ASCII Font (space to ~)
 *---------------------------------------------------------------------------*/
static const rt_uint8_t font_8x16[][16] = {
    {0x00,0x00,0x00,0x00,0x00,0x00,0x00,0x00,0x00,0x00,0x00,0x00,0x00,0x00,0x00,0x00}, // space
    {0x00,0x00,0x00,0xF8,0x00,0x00,0x00,0x00,0x00,0x00,0x00,0x33,0x00,0x00,0x00,0x00}, // !
    {0x00,0x10,0x0C,0x02,0x10,0x0C,0x02,0x00,0x00,0x00,0x00,0x00,0x00,0x00,0x00,0x00}, // "
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    {0x00,0x02,0x01,0x02,0x02,0x04,0x02,0x00,0x00,0x00,0x00,0x00,0x00,0x00,0x00,0x00}, // ~
};

/*---------------------------------------------------------------------------
 * Private variables
 *---------------------------------------------------------------------------*/
static struct rt_i2c_bus_device *s_i2c_bus = RT_NULL;
static rt_uint8_t s_frame_buffer[OLED_WIDTH * OLED_PAGES];
static rt_bool_t s_initialized = RT_FALSE;

/*---------------------------------------------------------------------------
 * Private functions
 *---------------------------------------------------------------------------*/

/* Write a command byte to SSD1306 */
static rt_err_t oled_write_cmd(rt_uint8_t cmd)
{
    rt_uint8_t buf[2] = {0x00, cmd};  /* Co=0, D/C#=0 (command) */
    struct rt_i2c_msg msg;

    msg.addr  = OLED_I2C_ADDR;
    msg.flags = RT_I2C_WR;
    msg.buf   = buf;
    msg.len   = 2;

    if (rt_i2c_transfer(s_i2c_bus, &msg, 1) != 1)
        return -RT_ERROR;

    return RT_EOK;
}

/* Write data bytes to SSD1306 */
static rt_err_t oled_write_data(rt_uint8_t *data, rt_uint16_t len)
{
    rt_uint8_t buf[129];  /* 1 control byte + up to 128 data bytes */
    struct rt_i2c_msg msg;

    if (len > 128) len = 128;

    buf[0] = 0x40;  /* Co=0, D/C#=1 (data) */
    rt_memcpy(&buf[1], data, len);

    msg.addr  = OLED_I2C_ADDR;
    msg.flags = RT_I2C_WR;
    msg.buf   = buf;
    msg.len   = len + 1;

    if (rt_i2c_transfer(s_i2c_bus, &msg, 1) != 1)
        return -RT_ERROR;

    return RT_EOK;
}

/*---------------------------------------------------------------------------
 * Public functions
 *---------------------------------------------------------------------------*/

rt_err_t oled_init(void)
{
    /* Find I2C bus */
    s_i2c_bus = (struct rt_i2c_bus_device *)rt_device_find(OLED_I2C_BUS_NAME);
    if (s_i2c_bus == RT_NULL)
    {
        LOG_E("I2C bus %s not found", OLED_I2C_BUS_NAME);
        return -RT_ERROR;
    }

    /* Verify device presence */
    rt_uint8_t dummy = 0x00;
    struct rt_i2c_msg msg = {
        .addr  = OLED_I2C_ADDR,
        .flags = RT_I2C_WR,
        .buf   = &dummy,
        .len   = 1
    };
    if (rt_i2c_transfer(s_i2c_bus, &msg, 1) != 1)
    {
        LOG_E("OLED not responding at 0x%02X", OLED_I2C_ADDR);
        return -RT_ERROR;
    }

    /* SSD1306 initialization sequence */
    oled_write_cmd(SSD1306_CMD_DISPLAY_OFF);         /* Display off */
    oled_write_cmd(SSD1306_CMD_SET_CLK_DIV);         /* Set clock divider */
    oled_write_cmd(0x80);                            /* Fosc=8, div=1 */
    oled_write_cmd(SSD1306_CMD_SET_MUX_RATIO);       /* Set multiplex ratio */
    oled_write_cmd(0x3F);                            /* 64 lines */
    oled_write_cmd(SSD1306_CMD_SET_DISPLAY_OFFSET);  /* Display offset */
    oled_write_cmd(0x00);                            /* No offset */
    oled_write_cmd(SSD1306_CMD_SET_START_LINE | 0);  /* Start line 0 */
    oled_write_cmd(SSD1306_CMD_CHARGE_PUMP);         /* Charge pump */
    oled_write_cmd(0x14);                            /* Enable charge pump */
    oled_write_cmd(SSD1306_CMD_MEMORY_MODE);         /* Memory mode */
    oled_write_cmd(0x00);                            /* Horizontal addressing */
    oled_write_cmd(SSD1306_CMD_SET_SEG_REMAP);       /* Segment remap (col 127 = SEG0) */
    oled_write_cmd(SSD1306_CMD_SET_COM_SCAN_DEC);    /* COM scan direction (remapped) */
    oled_write_cmd(SSD1306_CMD_SET_COM_PINS);        /* COM pins config */
    oled_write_cmd(0x12);                            /* Alternative COM, disable remap */
    oled_write_cmd(SSD1306_CMD_SET_CONTRAST);        /* Contrast */
    oled_write_cmd(0xCF);                            /* High contrast */
    oled_write_cmd(SSD1306_CMD_SET_PRECHARGE);       /* Pre-charge period */
    oled_write_cmd(0xF1);                            /* Phase1=1, Phase2=15 */
    oled_write_cmd(SSD1306_CMD_SET_VCOMH);           /* VCOMH deselect level */
    oled_write_cmd(0x40);                            /* ~0.77 x Vcc */
    oled_write_cmd(SSD1306_CMD_ENTIRE_DISPLAY_RAM);  /* Display from RAM */
    oled_write_cmd(SSD1306_CMD_NORMAL_DISPLAY);      /* Normal display (not inverted) */
    oled_write_cmd(SSD1306_CMD_DISPLAY_ON);          /* Display on */

    /* Clear frame buffer and display */
    rt_memset(s_frame_buffer, 0x00, sizeof(s_frame_buffer));
    oled_refresh();

    s_initialized = RT_TRUE;
    LOG_I("OLED SSD1306 initialized (128x64, I2C addr 0x%02X)", OLED_I2C_ADDR);

    return RT_EOK;
}

void oled_clear(void)
{
    rt_memset(s_frame_buffer, 0x00, sizeof(s_frame_buffer));
}

void oled_fill(void)
{
    rt_memset(s_frame_buffer, 0xFF, sizeof(s_frame_buffer));
}

void oled_refresh(void)
{
    if (!s_initialized && s_i2c_bus == RT_NULL)
        return;

    /* Set column address: 0 to 127 */
    oled_write_cmd(SSD1306_CMD_SET_COL_ADDR);
    oled_write_cmd(0x00);
    oled_write_cmd(0x7F);

    /* Set page address: 0 to 7 */
    oled_write_cmd(SSD1306_CMD_SET_PAGE_ADDR);
    oled_write_cmd(0x00);
    oled_write_cmd(0x07);

    /* Write frame buffer in chunks of 128 bytes (one page at a time) */
    for (rt_uint8_t page = 0; page < OLED_PAGES; page++)
    {
        oled_write_data(&s_frame_buffer[page * OLED_WIDTH], OLED_WIDTH);
    }
}

void oled_draw_pixel(rt_uint8_t x, rt_uint8_t y, rt_uint8_t color)
{
    if (x >= OLED_WIDTH || y >= OLED_HEIGHT)
        return;

    rt_uint16_t index = (y / 8) * OLED_WIDTH + x;
    rt_uint8_t bit = y % 8;

    if (color)
        s_frame_buffer[index] |= (1 << bit);
    else
        s_frame_buffer[index] &= ~(1 << bit);
}

void oled_draw_char(rt_uint8_t x, rt_uint8_t y, char ch, rt_uint8_t size)
{
    if (ch < ' ' || ch > '~')
        ch = ' ';

    rt_uint8_t c = ch - ' ';

    if (size == 16)
    {
        /* 8x16 font */
        for (rt_uint8_t i = 0; i < 8; i++)
        {
            rt_uint8_t upper = font_8x16[c][i];
            rt_uint8_t lower = font_8x16[c][i + 8];

            for (rt_uint8_t j = 0; j < 8; j++)
            {
                oled_draw_pixel(x + i, y + j, (upper >> j) & 0x01);
                oled_draw_pixel(x + i, y + j + 8, (lower >> j) & 0x01);
            }
        }
    }
    else
    {
        /* 6x8 font (default for size=12 or any other value) */
        for (rt_uint8_t i = 0; i < 6; i++)
        {
            rt_uint8_t line = font_6x8[c][i];
            for (rt_uint8_t j = 0; j < 8; j++)
            {
                oled_draw_pixel(x + i, y + j, (line >> j) & 0x01);
            }
        }
    }
}

void oled_draw_string(rt_uint8_t x, rt_uint8_t y, const char *str, rt_uint8_t size)
{
    rt_uint8_t char_width = (size == 16) ? 8 : 6;

    while (*str)
    {
        if (x + char_width > OLED_WIDTH)
        {
            x = 0;
            y += size;
        }
        if (y + size > OLED_HEIGHT)
            break;

        oled_draw_char(x, y, *str, size);
        x += char_width;
        str++;
    }
}

void oled_draw_hline(rt_uint8_t x, rt_uint8_t y, rt_uint8_t len)
{
    for (rt_uint8_t i = 0; i < len && (x + i) < OLED_WIDTH; i++)
    {
        oled_draw_pixel(x + i, y, 1);
    }
}

void oled_draw_rect(rt_uint8_t x1, rt_uint8_t y1, rt_uint8_t x2, rt_uint8_t y2)
{
    for (rt_uint8_t x = x1; x <= x2; x++)
    {
        oled_draw_pixel(x, y1, 1);
        oled_draw_pixel(x, y2, 1);
    }
    for (rt_uint8_t y = y1; y <= y2; y++)
    {
        oled_draw_pixel(x1, y, 1);
        oled_draw_pixel(x2, y, 1);
    }
}

void oled_display_on(rt_uint8_t on)
{
    if (!s_initialized)
        return;

    if (on)
        oled_write_cmd(SSD1306_CMD_DISPLAY_ON);
    else
        oled_write_cmd(SSD1306_CMD_DISPLAY_OFF);
}

void oled_set_contrast(rt_uint8_t contrast)
{
    if (!s_initialized)
        return;

    oled_write_cmd(SSD1306_CMD_SET_CONTRAST);
    oled_write_cmd(contrast);
}

/*---------------------------------------------------------------------------
 * MSH Commands
 *---------------------------------------------------------------------------*/
static void oled_test(int argc, char **argv)
{
    if (!s_initialized)
    {
        rt_kprintf("OLED not initialized\n");
        return;
    }

    oled_clear();
    oled_draw_string(0, 0, "OLED Test", 16);
    oled_draw_string(0, 20, "128x64 SSD1306", 12);
    oled_draw_string(0, 32, "Guardian F407", 12);
    oled_draw_hline(0, 50, 128);
    oled_draw_string(0, 54, "RT-Thread", 12);
    oled_refresh();

    rt_kprintf("OLED test pattern displayed\n");
}
MSH_CMD_EXPORT(oled_test, OLED display test);
